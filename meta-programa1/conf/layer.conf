## meta-programa1/conf/layer.conf
```bitbake
# We have a conf and classes directory, add to BBPATH

BBPATH .= ":${LAYERDIR}"



# We have recipes-* directories, add to BBFILES

BBFILES += "${LAYERDIR}/recipes-*/*.bb \
	    ${LAYERDIR}/recipes-*/*/*.bbappend"



BBFILE_COLLECTIONS += "programa"
BBFILE_PATTERN_programa = "^${LAYERDIR}/"
BBFILE_PRIORITY_programa = "5"
LAYERVERSION_programa = "4"
LAYERSERIES_COMPAT_programa = "dunfell"
```
